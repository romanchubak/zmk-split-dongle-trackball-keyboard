#include <dt-bindings/zmk/keys.h>

/ {
    keymap {
        compatible = "zmk,keymap";

        default_layer {
			label = "default";
            bindings = <
                &kp SPACE
            >;
        };
    };
};
