## config/boards/shields/one_key/Kconfig.defconfig
```kconfig
if SHIELD_ONE_KEY 

config ZMK_KEYBOARD_NAME
    default "keytrackball"
    
config ZMK_SPLIT_ROLE_CENTRAL
    default y

config ZMK_USB
    default y

endif

if SHIELD_ONE_KEY || SHIELD_TRACKBALL

config ZMK_SPLIT
    default y

config ZMK_BLE
    default y

endif
```

## config/boards/shields/one_key/Kconfig.shield
```kconfig
config SHIELD_ONE_KEY
	def_bool $(shields_list_contains,one_key)

config SHIELD_TRACKBALL
	def_bool $(shields_list_contains,trackball)
```

## config/boards/shields/tdtsk/Kconfig.defconfig
```kconfig
if SHIELD_TDTSK_CENTRAL

	config ZMK_KEYBOARD_NAME
		default "tdtsk"

	config ZMK_SPLIT_ROLE_CENTRAL
		default y

endif

if SHIELD_TDTSK_CENTRAL || SHIELD_TDTSK_TRACKBALL 

	config ZMK_SPLIT
		default y

	config ZMK_BLE
		default y

endif
```

## config/boards/shields/tdtsk/Kconfig.shield
```kconfig
config SHIELD_TDTSK_CENTRAL
	def_bool $(shields_list_contains,tdtsk_central)

config SHIELD_TDTSK_TRACKBALL
	def_bool $(shields_list_contains,tdtsk_trackball)
```

## config/boards/shields/trackball/Kconfig.defconfig
```kconfig
if SHIELD_TRACKBALL

	config ZMK_KEYBOARD_NAME
		default "trackball"

	config ZMK_USB
		default y

	config ZMK_BLE
		default y

endif
```
