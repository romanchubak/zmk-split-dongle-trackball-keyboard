#include "one_key.dtsi"

&trackball_split: trackball_split {
	device = <&pmw3360>;
};

&xiao_spi {
	status = "okay";
	cs-gpios = <&xiao_d 1 GPIO_ACTIVE_LOW>;

	pmw3360: pmw3360@0 {
		compatible = "pixart,pmw3360";
		reg = <0>;
		spi-max-frequency = <2000000>;
		irq-gpios = <&xiao_d 0 GPIO_ACTIVE_LOW>;
		status = "okay";
	};
};
